## dts/bindings/power/argisense,lt3582.yaml
```yaml
# SPDX-License-Identifier: Apache-2.0

description: |
  Linear Technology / Analog Devices LT3582 dual-output positive/negative
  rail generator used by the ArgiSense pH analog front-end.

  The schematic names the enable signal U_O_D_ANA_PWR_EN and the rails
  +5V_AN / -5V_AN. If the product needs runtime rail configuration over I2C,
  add the confirmed I2C address and enable this node with a driver.

compatible: "argisense,lt3582"

include: [i2c-device.yaml]

properties:
  enable-gpios:
    type: phandle-array
    description: GPIO that enables the analog positive/negative rails.

  positive-output-millivolt:
    type: int
    default: 5000
    description: Expected positive analog rail voltage.

  negative-output-abs-millivolt:
    type: int
    default: 5000
    description: Absolute voltage magnitude of the negative analog rail.

  startup-delay-ms:
    type: int
    default: 20
    description: Delay after enabling the analog rails before ADC/DAC access.
```

## dts/bindings/sensor/argisense,dynament-platinum-hydrocarbon.yaml
```yaml
# SPDX-License-Identifier: Apache-2.0

description: |
  Dynament Platinum Series hydrocarbon infrared gas sensor on a UART bus.

  The ArgiSense methane + pressure board uses the digital UART interface and
  the Dynament/Premier live-data-simple request described in AN0007. The sensor
  reports gas concentration as a little-endian IEEE-754 percentage of full-scale
  volume in the live data response.

compatible: "argisense,dynament-platinum-hydrocarbon"

include: [sensor-device.yaml, uart-device.yaml]

properties:
  gas-type:
    type: string
    required: true
    enum:
      - "methane"
      - "propane"
      - "methane-co2"
      - "methane-propane"
    description: Target gas configuration ordered for the sensor.

  protocol:
    type: string
    required: true
    enum:
      - "dynament-premier-live-data-simple"
      - "modbus-rtu"
    description: Digital protocol configured for the sensor UART.

  full-scale-percent-x100:
    type: int
    required: true
    description: |
      Sensor full-scale methane range in percent volume multiplied by 100.
      Examples: 500 means 5.00 percent volume, 10000 means 100.00 percent
      volume.

  live-data-variable-id:
    type: int
    required: true
    description: Dynament variable ID for the live-data-simple structure.

  warmup-time-ms:
    type: int
    required: true
    description: Sensor warm-up time after power is first applied.

  read-period-ms:
    type: int
    required: true
    description: Nominal polling period for live-data-simple reads.

  logic-level-mv:
    type: int
    required: true
    description: Nominal UART logic level used by the sensor.
```

## dts/bindings/sensor/argisense,htu21d.yaml
```yaml
# SPDX-License-Identifier: Apache-2.0

description: |
  Measurement Specialties / TE Connectivity HTU21D humidity and temperature
  sensor on an I2C bus.

compatible: "argisense,htu21d"

include: [sensor-device.yaml, i2c-device.yaml]

properties:
  part-number:
    type: string
    default: "HTU21D"
    description: Manufacturer orderable part number.
```

## dts/bindings/sensor/argisense,ms5803-05ba.yaml
```yaml
# SPDX-License-Identifier: Apache-2.0

description: |
  TE Connectivity MS5803-05BA digital absolute pressure sensor.

  The MS580305BA01-00 variant is the 5 bar / 500 kPa member of the
  MS5803 family. It supports SPI and I2C; the ArgiSense methane + pressure
  board uses SPI with the sensor PS pin held low.

compatible: "argisense,ms5803-05ba"

include: [sensor-device.yaml, spi-device.yaml]

properties:
  part-number:
    type: string
    required: true
    description: Manufacturer orderable part number.

  pressure-range-kpa:
    type: int
    required: true
    description: Nominal absolute pressure range in kPa.

  resolution-bits:
    type: int
    required: true
    description: Sensor ADC output resolution in bits.
```
