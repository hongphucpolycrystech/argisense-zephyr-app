## app/Kconfig
```kconfig
# SPDX-License-Identifier: Apache-2.0

menu "ArgiSense application"

config ARGISENSE_MEASUREMENT_PERIOD_SECONDS
	int "Measurement period in seconds"
	default 60
	range 1 86400
	help
	  Time between sensor measurement windows. The application powers down
	  switched external rails during this interval so the kernel can enter
	  low-power idle states.

config ARGISENSE_PRE_RAIL_ALWAYS_ON
	bool "Keep +3V3_PRE enabled while idle"
	default y
	help
	  Keep the pre-sensor rail powered between measurement windows. This is
	  enabled by default because the selected Dynament Platinum methane sensor
	  is designed for continuous powered operation, and repeated short-interval
	  power cycling is outside the intended use of that product.

config ARGISENSE_PRE_RAIL_SETTLE_MS
	int "Pre-sensor 3V3 rail settle time in milliseconds"
	default 50
	range 0 5000
	help
	  Delay after enabling +3V3_PRE before touching sensors powered from it.

config ARGISENSE_ANALOG_RAIL_SETTLE_MS
	int "Analog rail settle time in milliseconds"
	default 20
	range 0 5000
	help
	  Delay after enabling analog rails before a measurement window begins.

config ARGISENSE_MEASUREMENT_WINDOW_MS
	int "Measurement window in milliseconds"
	default 1000
	range 1 60000
	help
	  Placeholder time that keeps sensor rails enabled for acquisition.
	  Sensor drivers can later replace this window with real sampling logic.

config ARGISENSE_PRESSURE_PS_ACTIVE
	bool "Drive pressure PS signal high during measurements"
	default n
	help
	  Drive PRES_SEN_PS high while the pressure sensor rail is enabled. The
	  selected MS580305BA01-00 / MS5803-05BA pressure sensor uses PS low for SPI
	  and PS high for I2C. The methane + pressure board maps the sensor on spi1,
	  so the default is n to keep PS low during measurements.

config ARGISENSE_DAC_POWER_DURING_MEASUREMENT
	bool "Power DAC rail during measurement windows"
	default y
	help
	  Power the 4-20 mA DAC boost rail during each measurement window so the
	  GP8302 current-loop outputs can be refreshed, then turn it back off in
	  idle to preserve the duty-cycled power model.

config ARGISENSE_DAC_POWER_IDLE
	bool "Keep DAC rail enabled in idle"
	default y
	help
	  Keep the GP8302/current-loop rail powered after the output is refreshed
	  so the 4-20 mA outputs remain active between measurement cycles. Disable
	  this only when the product intentionally duty-cycles the analog output.

config ARGISENSE_DAC_MIN_CURRENT_UA
	int "Normal minimum DAC loop current in microamps"
	default 4000
	range 0 25000
	help
	  Normal low-end current for each 4-20 mA current-loop output channel.

config ARGISENSE_DAC_MAX_CURRENT_UA
	int "Normal maximum DAC loop current in microamps"
	default 20000
	range 0 25000
	help
	  Normal high-end current for each 4-20 mA current-loop output channel.

config ARGISENSE_DAC_FAULT_CURRENT_UA
	int "DAC fault loop current in microamps"
	default 3600
	range 0 25000
	help
	  Current command used when the source sensor value for a DAC channel is
	  invalid. This is the default low-fault value for industrial loops.

config ARGISENSE_METHANE_DAC_RANGE_LOW_PPM
	int "Methane DAC channel low range in ppm"
	default 0
	help
	  Methane concentration mapped to 4 mA on DAC channel 0.

config ARGISENSE_METHANE_DAC_RANGE_HIGH_PPM
	int "Methane DAC channel high range in ppm"
	default 1000000
	help
	  Methane concentration mapped to 20 mA on DAC channel 0. The default
	  matches a 0-100% volume methane Platinum sensor. Use 50000 for a 0-5%
	  volume variant.

config ARGISENSE_METHANE_SENSOR_WARMUP_SECONDS
	int "Dynament methane sensor warm-up time in seconds"
	default 60
	range 0 600
	help
	  Time after first power before the Dynament Platinum digital gas reading is
	  expected to represent the calculated methane value. During warm-up, the
	  digital output may report a fault-style value.

config ARGISENSE_METHANE_SENSOR_READ_PERIOD_MS
	int "Dynament methane live-data polling period in milliseconds"
	default 5000
	range 100 60000
	help
	  Nominal period for the live-data-simple UART request shown in Dynament
	  AN0007.

config ARGISENSE_HUMIDITY_SENSOR_READ_PERIOD_SECONDS
	int "HTU21D humidity read period in seconds"
	default 60
	range 1 86400
	help
	  Nominal period for HTU21D relative humidity and ambient temperature
	  sampling on the methane + pressure board.

config ARGISENSE_PRESSURE_DAC_RANGE_LOW_PA
	int "Pressure DAC channel low range in pascals"
	default 0
	help
	  Pressure value mapped to 4 mA on DAC channel 1.

config ARGISENSE_PRESSURE_DAC_RANGE_HIGH_PA
	int "Pressure DAC channel high range in pascals"
	default 500000
	help
	  Pressure value mapped to 20 mA on DAC channel 1.

menu "RS485 firmware update"

config ARGISENSE_RS485_DFU
	bool "Enable firmware update over RS485 Modbus registers"
	depends on BOOTLOADER_MCUBOOT
	depends on IMG_MANAGER
	depends on FLASH
	depends on FLASH_MAP
	depends on STREAM_FLASH
	default y
	select IMG_ENABLE_IMAGE_CHECK
	select IMG_ERASE_PROGRESSIVELY
	help
	  Add an ArgiSense Modbus register window that receives signed MCUboot
	  images over RS485, writes them to the secondary image slot, verifies
	  the uploaded image hash, and can mark it for a test boot.

config ARGISENSE_RS485_DFU_MAX_CHUNK_BYTES
	int "Maximum RS485 DFU chunk size in bytes"
	depends on ARGISENSE_RS485_DFU
	default 96
	range 16 128
	help
	  Maximum payload bytes accepted by one RS485 DFU write command.
	  The value must be even because each Modbus holding register carries
	  two data bytes. 96 bytes fits comfortably inside the Zephyr Modbus
	  RTU buffer and works well on noisy RS485 links.

config ARGISENSE_RS485_DFU_UNLOCK_KEY
	hex "RS485 DFU service unlock key"
	depends on ARGISENSE_RS485_DFU
	default 0xA65D
	help
	  16-bit service key that must be written to the DFU unlock register
	  before image metadata, payload, or control registers accept writes.
	  Override this in a private production config if RS485 DFU remains
	  enabled in field firmware.

config ARGISENSE_RS485_DFU_UNLOCK_WINDOW_SECONDS
	int "RS485 DFU unlock window in seconds"
	depends on ARGISENSE_RS485_DFU
	default 1800
	range 60 7200
	help
	  Number of seconds that DFU writes remain enabled after a valid unlock
	  key. Choose a value long enough for the slowest supported RS485 baud
	  rate and firmware image size.

endmenu

menu "USB-C device support"

config ARGISENSE_USB_DEVICE
	bool "Initialize ArgiSense USB device-next composite device"
	depends on USB_DEVICE_STACK_NEXT
	depends on USBD_CDC_ACM_CLASS
	default n
	help
	  Initialize the Zephyr USB device-next stack from application code.
	  This is used by the USB update profile so more than one CDC ACM
	  function can be registered on the same USB-C connector.

config ARGISENSE_USB_MANUFACTURER_STRING
	string "USB manufacturer string"
	depends on ARGISENSE_USB_DEVICE
	default "ArgiSense"
	help
	  USB manufacturer string descriptor used by the ArgiSense USB device.

config ARGISENSE_USB_PRODUCT_STRING
	string "USB product string"
	depends on ARGISENSE_USB_DEVICE
	default "ArgiSense USB-C Console and Firmware Update"
	help
	  USB product string descriptor used by the ArgiSense USB device.

config ARGISENSE_USB_VID
	hex "USB vendor ID"
	depends on ARGISENSE_USB_DEVICE
	default 0x2fe3
	help
	  USB vendor ID used by the ArgiSense USB device. Replace this before
	  production if a product-specific VID is assigned.

config ARGISENSE_USB_PID
	hex "USB product ID"
	depends on ARGISENSE_USB_DEVICE
	default 0x0005
	help
	  USB product ID used by the ArgiSense USB update profile.

config ARGISENSE_USB_SELF_POWERED
	bool "Mark USB device as self-powered"
	depends on ARGISENSE_USB_DEVICE
	default n
	help
	  Set the self-powered attribute in the USB configuration descriptor.

config ARGISENSE_USB_MAX_POWER
	int "USB maximum power descriptor value"
	depends on ARGISENSE_USB_DEVICE
	default 125
	range 0 250
	help
	  USB bMaxPower value in 2 mA units. The default advertises 250 mA.

endmenu

endmenu

menu "Zephyr"
source "Kconfig.zephyr"
endmenu
```

## boards/argisense/argisense_mp_u575rg/Kconfig.argisense_mp_u575rg
```kconfig
# SPDX-License-Identifier: Apache-2.0

config BOARD_ARGISENSE_MP_U575RG
	select SOC_STM32U575XX
```

## boards/argisense/argisense_mp_u575rg/board.yml
```yaml
board:
  name: argisense_mp_u575rg
  full_name: ArgiSense Methane Pressure STM32U575RG
  vendor: argisense
  socs:
    - name: stm32u575xx
```

## boards/argisense/argisense_ph_u575rg/board.yml
```yaml
board:
  name: argisense_ph_u575rg
  full_name: ArgiSense pH STM32U575RG
  vendor: argisense
  socs:
    - name: stm32u575xx
```

## boards/argisense/argisense_u575rg/board.yml
```yaml
board:
  name: argisense_u575rg
  full_name: ArgiSense STM32U575RG
  vendor: argisense
  socs:
    - name: stm32u575xx
```

## drivers/Kconfig
```kconfig
# SPDX-License-Identifier: Apache-2.0

# Add out-of-tree driver Kconfig sources here as they are implemented.
# Examples:
# rsource "sim7600/Kconfig"
# rsource "mlx90640/Kconfig"
rsource "adc/Kconfig"
rsource "dac/Kconfig"
rsource "sensor/Kconfig"
```

## drivers/adc/Kconfig
```kconfig
# SPDX-License-Identifier: Apache-2.0

config ARGISENSE_ADS124S08
	bool "ADS124S08 24-bit SPI ADC driver"
	default y
	depends on ADC
	depends on SPI
	depends on GPIO
	depends on DT_HAS_ARGISENSE_ADS124S08_ENABLED
	select ADC_CONFIGURABLE_INPUTS
	help
	  Enable the ADS124S08 SPI ADC driver used by the ArgiSense pH
	  front-end. The driver provides a minimal Zephyr ADC API
	  implementation plus helper calls for pH raw acquisition and PT1000
	  measurements.
```

## drivers/dac/Kconfig
```kconfig
# SPDX-License-Identifier: Apache-2.0

config DAC_GP8302
	bool "GP8302 0-25 mA current-loop DAC driver"
	default y
	depends on DAC
	depends on I2C
	depends on DT_HAS_ARGISENSE_GP8302_ENABLED
	help
	  Enable the GP8302 I2C current-loop DAC driver. The driver exposes the
	  chip through Zephyr's DAC API as one 12-bit output channel.

config DAC_AD5675_I2C
	bool "AD5675 8-channel 16-bit I2C voltage DAC driver"
	default y
	depends on DAC
	depends on I2C
	depends on DT_HAS_ARGISENSE_AD5675_I2C_ENABLED
	help
	  Enable the AD5675 I2C voltage DAC driver used by the pH bias
	  network. The driver exposes the chip through Zephyr's DAC API as
	  eight 16-bit voltage output channels.
```

## drivers/sensor/Kconfig
```kconfig
# SPDX-License-Identifier: Apache-2.0

rsource "ms5803_05ba/Kconfig"
rsource "dynament_platinum/Kconfig"
rsource "htu21d/Kconfig"
```

## drivers/sensor/dynament_platinum/Kconfig
```kconfig
# SPDX-License-Identifier: Apache-2.0

config DYNAMENT_PLATINUM_HYDROCARBON
	bool "Dynament Platinum hydrocarbon gas sensor"
	default y
	depends on SENSOR
	depends on SERIAL
	depends on DT_HAS_ARGISENSE_DYNAMENT_PLATINUM_HYDROCARBON_ENABLED
	help
	  Enable the Dynament Platinum Series hydrocarbon infrared gas sensor
	  driver. The driver uses the live-data-simple UART protocol and exposes
	  methane concentration through ArgiSense private Sensor API channels.
```

## drivers/sensor/htu21d/Kconfig
```kconfig
# SPDX-License-Identifier: Apache-2.0

config ARGISENSE_HTU21D
	bool "HTU21D humidity and temperature sensor"
	default y
	depends on SENSOR
	depends on I2C
	depends on DT_HAS_ARGISENSE_HTU21D_ENABLED
	help
	  Enable the HTU21D humidity and temperature sensor driver used by the
	  ArgiSense methane + pressure board. The driver uses the Zephyr Sensor
	  API and exposes SENSOR_CHAN_HUMIDITY and SENSOR_CHAN_AMBIENT_TEMP.
```

## drivers/sensor/ms5803_05ba/Kconfig
```kconfig
# SPDX-License-Identifier: Apache-2.0

config MS5803_05BA
	bool "TE MS5803-05BA pressure and temperature sensor"
	default y
	depends on SENSOR
	depends on SPI
	depends on DT_HAS_ARGISENSE_MS5803_05BA_ENABLED
	help
	  Enable the TE Connectivity MS5803-05BA digital absolute pressure
	  sensor driver. The driver uses the Zephyr Sensor API and supports the
	  SPI wiring used by the ArgiSense methane + pressure board.
```

## dts/bindings/adc/argisense,ads124s08.yaml
```yaml
# SPDX-License-Identifier: Apache-2.0

description: |
  Texas Instruments ADS124S08 24-bit delta-sigma ADC used by the ArgiSense
  pH front-end.

  The schematic uses this device for ISFET/REFET monitoring and PT1000
  measurement. Keep the devicetree node disabled until the final MCU pin
  mapping for ADC_SPI_CS/SCLK/DIN/DOUT, ADC_SRDY, ADC_RESET, and ADC_START
  is confirmed.

compatible: "argisense,ads124s08"

include: [adc-controller.yaml, spi-device.yaml]

properties:
  "#io-channel-cells":
    const: 1

  reset-gpios:
    type: phandle-array
    description: Active-low RESET pin.

  drdy-gpios:
    type: phandle-array
    description: Data-ready pin. The schematic signal is ADC_SRDY.

  start-sync-gpios:
    type: phandle-array
    description: START/SYNC pin. The schematic signal is ADC_START.

  reference-millivolt:
    type: int
    default: 2500
    description: ADC reference voltage in millivolts.

  idac-current-microamp:
    type: int
    default: 250
    enum:
      - 0
      - 10
      - 50
      - 100
      - 250
      - 500
      - 750
      - 1000
      - 1500
      - 2000
    description: Current source setting used for the PT1000 input path.

  conversion-timeout-ms:
    type: int
    default: 250
    description: Timeout while waiting for DRDY after a single-shot conversion.

  channel-labels:
    type: string-array
    description: Logical names for the external analog inputs.

  pt1000-positive-input:
    type: int
    default: 2
    description: ADS124S08 AIN index connected to PT1000_P.

  pt1000-negative-input:
    type: int
    default: 3
    description: ADS124S08 AIN index connected to PT1000_N.

io-channel-cells:
  - input
```

## dts/bindings/dac/argisense,ad5675-i2c.yaml
```yaml
# SPDX-License-Identifier: Apache-2.0

description: |
  Analog Devices AD5675 8-channel 16-bit I2C DAC used by the ArgiSense pH
  ISFET/REFET bias network.

  The schematic address is 0x0c. DAC_I2C_SCL/DAC_I2C_SDA and DAC_RESET are
  routed to the MCU. LDAC is optional because Sensor_Platform_V1 pH_V1_0 ties
  LDAC low through a 0 ohm option and exposes only a test point.

compatible: "argisense,ad5675-i2c"

include: [dac-controller.yaml, i2c-device.yaml]

properties:
  "#io-channel-cells":
    const: 1

  reset-gpios:
    type: phandle-array
    description: Active-low DAC reset pin.

  ldac-gpios:
    type: phandle-array
    description: |
      Optional active-low LDAC pin. Current pH_V1_0 hardware ties LDAC low
      instead of routing it to the MCU, so the board DTS should omit this
      property unless a later PCB revision connects LDAC to a GPIO.

  reference-millivolt:
    type: int
    default: 2500
    description: External reference voltage supplied by REF3025.

  gain:
    type: int
    default: 1
    enum:
      - 1
      - 2
    description: |
      AD5675 output amplifier gain. Gain 1 gives a 0 V to VREF span, and
      gain 2 gives a 0 V to 2 x VREF span.

  resolution-bits:
    type: int
    const: 16
    description: AD5675 DAC resolution.

  channel-labels:
    type: string-array
    description: Logical pH bias output names for channels VOUT0..VOUT7.

io-channel-cells:
  - output
```

## dts/bindings/dac/argisense,gp8302.yaml
```yaml
# SPDX-License-Identifier: Apache-2.0

description: GP8302 single-channel current-loop DAC

compatible: "argisense,gp8302"

include: [dac-controller.yaml, i2c-device.yaml]

properties:
  "#io-channel-cells":
    const: 1

  output-source:
    type: string
    required: true
    description: |
      Logical process value driven by this DAC device, for example methane or
      pressure.

  max-current-microamp:
    type: int
    default: 25000
    description: Maximum output current supported by the GP8302 circuit.

  resolution-bits:
    type: int
    default: 12
    description: GP8302 DAC resolution in bits.

  output-register:
    type: int
    default: 0x02
    description: GP8302 register used to update the output current DAC code.

io-channel-cells:
  - output
```
